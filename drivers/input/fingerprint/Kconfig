## drivers/input/fingerprint/fpc1145/Kconfig
```kconfig
config FPC1145_PLATFORM
	bool "FPC1145 Fingerprint Sensor"
	default y
	---help---
	  This sensor is used in Sony Xperia XZ Premium (maple).
	  Select this if you have this device.
```

## drivers/misc/bu520x1nvx/Kconfig
```kconfig
config HALL_BU520X1NVX
	bool "BU520X1NVX Hall sensor"
	default y
	---help---
	  This hall sensor is usually found in Sony phones.
```

## drivers/misc/ldo_vibrator/Kconfig
```kconfig
config LDO_VIBRATOR
	bool "LDO Vibrator"
	default y
	---help---
	  Vibrators usually found in Sony phones.
```

## drivers/misc/sim_detect/Kconfig
```kconfig
config SIM_DETECT
	bool "SIM tray open/close detection"
	default y
	---help---
	  This driver registers a new switch, and changes its status every time SIM tray
	  is opened or closed. System may want to make use of this event to re-initialize
	  modem.
```
